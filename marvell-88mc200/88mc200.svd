# 88MC200 register map
File version: 1.0
Registers are 32-bit, read-write, reset 0x0 unless marked. A register's access mark holds for its fields unless they carry their own. Offsets are from the block's base; lines under a group give offsets from that group; [hi:lo] are bit positions; {n}, {i} and the like mark numbered series; 'fields as' and 'values as' point back to an identical list; <NAME> marks a mode.

## Memory map
0x46060000 GPIO size 0x1000

## Interrupts
0 FAKEINTERRUPT (GPIO) — FAKE INTERRUPT TO MAKE cortex-m-rt NOT COMPLAIN THAT .vector_table.interrupts is empty

## GPIO
Base 0x46060000
0x18 GPSR0
0x24 GPCR0
0x54 GSDR0
